# ibex32 register map
File version: 0.1
From ibex32,model device generator
Registers are 64-bit, read-write, no defined reset value unless marked. A register's access mark holds for its fields unless they carry their own. Offsets are from the block's base; lines under a group give offsets from that group; [hi:lo] are bit positions; {n}, {i} and the like mark numbered series; 'fields as' and 'values as' point back to an identical list; <NAME> marks a mode.

## Memory map
0x00008000 riscv_clint0_0 size 0x8000 — From riscv,clint0,control peripheral generator

## riscv_clint0_0 — From riscv,clint0,control peripheral generator
Base 0x00008000
0x00 msip_0 32-bit — MSIP Register for hart 0
0x4000 mtimecmp_0 — MTIMECMP Register for hart 0
0xBFF8 mtime
